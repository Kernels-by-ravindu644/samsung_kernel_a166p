## custom_defconfigs/custom_defconfig
```kconfig
# disable samsung anti-root stuffs
CONFIG_UH=n
CONFIG_SECURITY_DEFEX=n
CONFIG_PROCA=n
CONFIG_FIVE=n

# KernelSU-Next
CONFIG_KSU=y

# BBG - https://github.com/vc-teahouse/Baseband-guard
CONFIG_BBG=y
CONFIG_LSM="landlock,lockdown,yama,loadpin,safesetid,integrity,selinux,smack,tomoyo,apparmor,bpf,baseband_guard"

# ntsync
CONFIG_NTSYNC=y

# bbrv3
CONFIG_TCP_CONG_ADVANCED=y
CONFIG_TCP_CONG_BBR3=y

# qdiscs: fq/fq_codel/cake/pie/fq_pie for bufferbloat control + BBR3 pacing (fq)
CONFIG_NET_SCH_FQ=y
CONFIG_NET_SCH_FQ_CODEL=y
CONFIG_NET_SCH_CAKE=y
CONFIG_NET_SCH_PIE=y
CONFIG_NET_SCH_FQ_PIE=y
```
