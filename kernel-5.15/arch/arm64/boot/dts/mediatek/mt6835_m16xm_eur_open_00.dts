/* 
 * Generated by Samsung 
 * If these files should be changed, then please make a sync with MTK
*/

/dts-v1/;
/plugin/;

#include "../mediatek/S98902AA1.dts"
#include "mt6835-m16xm_common.dtsi"

/* Add Samsung configuration over here */
/ {
	compatible = "Samsung,M16XM EUR OPEN 00", "Mediatek,MT6835";
	dtbo-hw_rev = <0x0>;
	dtbo-hw_rev_end = <0x20>;	
};

/*End of this file, DO NOT ADD ANYTHING HERE*/

